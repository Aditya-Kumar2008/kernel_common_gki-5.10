## drivers/gpu/drm/msm/dsi/panel_nt36532/Kconfig
```kconfig
config DRM_MSM_DSI_PANEL_NT36532
tristate "NT36532 DSI Panel Driver"
depends on DRM_MSM_DSI
help
  Driver for NT36532 DSI panel used in POCO PAD 5G (ruan)
```

## drivers/input/xiaomi/Kconfig
```kconfig
config XIAOMI_HALL
tristate "Xiaomi Hall Sensor Driver"
depends on INPUT
help
  Driver for Xiaomi hall sensor used in POCO PAD 5G (ruan) for lid detection
```
